## conf/layer.conf
```bitbake
# We have a conf and classes directory, add to BBPATH
BBPATH .= ":${LAYERDIR}"

# We have a recipes directory, add to BBFILES
BBFILES += "${LAYERDIR}/recipes-*/*/*.bb \
	${LAYERDIR}/recipes-*/*/*.bbappend"

BBFILE_COLLECTIONS += "fusion-swupdate"
BBFILE_PATTERN_fusion-swupdate := "^${LAYERDIR}/"
BBFILE_PRIORITY_fusion-swupdate = "7"

IMAGE_INSTALL_append_colibri-imx7-emmc = " swupdate swupdate-www swupdate-tools e2fsprogs-resize2fs"
IMAGE_INSTALL_append_colibri-imx7-emmc-1370 = " swupdate swupdate-www swupdate-tools e2fsprogs-resize2fs"

PREFERRED_PROVIDER_u-boot-fw-utils = "u-boot-toradex-fw-utils"

LAYERSERIES_COMPAT_fusion-swupdate = "sumo thud"
```
